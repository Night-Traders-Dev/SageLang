/* Kernel linker script - generated by Sage */
ENTRY(_start)

PHDRS
{
	text PT_LOAD;
	note PT_NOTE;
}

SECTIONS
{
	. = 1048576;
	KERNEL_START = .;

	.text ALIGN(4096) :text
	{
		*(.multiboot)
		*(.text .text.*)
	}

	.note ALIGN(4) :note
	{
		*(.note)
	}

	.rodata ALIGN(4096) :
	{
		*(.rodata .rodata.*)
	}

	.data ALIGN(4096) :
	{
		*(.data .data.*)
	}

	.bss ALIGN(4096) :
	{
		__bss_start = .;
		*(.bss .bss.*)
		*(COMMON)
		__bss_end = .;
	}

	KERNEL_END = .;
}
